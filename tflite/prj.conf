## CMakeLists.txt
```
cmake_minimum_required(VERSION 3.20.0)

find_package(Zephyr REQUIRED HINTS $ENV{ZEPHYR_BASE})
project(zephyr_tflite_demo)

zephyr_include_directories(src)

target_sources(app PRIVATE src/main.cpp)
```

## west.yml
```
manifest:
  remotes:
    - name: tensorflow
      url: https://github.com/tensorflow
  projects:
    - name: tflite-micro
      remote: tensorflow
      revision: r2.15.0
      path: modules/lib/tflite-micro
```

## prj.conf
```kconfig
CONFIG_SERIAL=y
CONFIG_CONSOLE=y
CONFIG_UART_CONSOLE=y
CONFIG_LOG=y
CONFIG_LOG_DEFAULT_LEVEL=3

CONFIG_CPP=y
CONFIG_REQUIRES_FULL_LIBC=y
CONFIG_STD_CPP17=y
CONFIG_TENSORFLOW_LITE_MICRO=y

CONFIG_MAIN_STACK_SIZE=8192
```

## src/main.c
```c
#include <zephyr/kernel.h>
#include <zephyr/logging/log.h>

#include "tensorflow/lite/micro/micro_mutable_op_resolver.h"
#include "tensorflow/lite/micro/micro_interpreter.h"
#include "tensorflow/lite/micro/system_setup.h"
#include "tensorflow/lite/schema/schema_generated.h"


#include <model_data.h>

LOG_MODULE_REGISTER(tflite,LOG_LEVEL_INF);

constexpr int kTensorArenaSize = 2 * 1024; 
alignas(16) static uint8_t tensor_arena[kTensorArenaSize];

int main(void)
{
    LOG_INF("STARTING THE AI MODELS");
    
    tflite::InitializeAgent();

    const tflite::Model* model = tflite::GetModel(g_model);
    if(model->version() != TFLITE_SCHEMA_VERSION)
    {
        LOG_INF("Version outdated or mismatch");
    }

    tflite::MicroMutableOpResolver <1> resolver;
    if (resolver.AddFullyConnected() != kTfLiteOk) {
        LOG_ERR("Failed to register operations.");
        return 0;
    }

    tflite::MicroInterpreter interpreter(model,resolver,tensor_arena,kTensorArenaSize);
    if(interpreter.AllocateTensors() != kTfLiteOk)
    {
        LOG_ERR("Failed to allocate tensors");
        return 0;
    }

    TfLiteIntArray* input=interpreter.input(0);
    TfLiteIntArray* output=interpreter.output(0);

    int current_sensor_val=0;

    while(1)
    {
        input->data.f[0]=current_sensor_val;
        
        if (interpreter.Invoke() != kTfLiteOk) {
            LOG_ERR("Inference failed!");
            break;
        }

        float prediction = output->data.f[0];


    }
    return 0;
}
```
