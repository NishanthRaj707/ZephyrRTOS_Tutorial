## CMakeLists.txt
```
cmake_minimum_required(VERSION 3.20.0)

# Load Zephyr build environment
find_package(Zephyr REQUIRED HINTS $ENV{ZEPHYR_BASE})

project(zephyr_thread_demo)

# Target executable source files
target_sources(app PRIVATE src/main.c)
```

## prj.conf
```kconfig
# Enable GPIO Driver subsystem
CONFIG_GPIO=y

# Thread Priority Configuration
CONFIG_NUM_COOP_PRIORITIES=5
CONFIG_NUM_PREEMPT_PRIORITIES=10

# Logging subsystem configuration
CONFIG_LOG=y
CONFIG_LOG_MODE_IMMEDIATE=n
CONFIG_LOG_DEFAULT_LEVEL=3

# Kernel Debugging & Thread Tracking
CONFIG_THREAD_NAME=y
```

## app.overlay
```dts
/{
    aliases{
        led = &status_led;
    };
    
    leds{
        compatible = "gpio-leds";
        status_led:led0{
            label = "Status LED";
            gpios =<&gpio0 2 GPIO_ACTIVE_HIGH>;
        };
    };

};
```

## src/main.c
```c
#include<zephyr/kernel.h>
#include<zephyr/logging/log.h>
#include <zephyr/drivers/gpio.h>

#define STACK_SIZE (1024)
#define COOP_PRIORITY (-2)
#define PREEMPT_PRIORITY (1)

#define LED DT_ALIAS(led)
#if !DT_NODE_EXISTS(LED)
#error "No led device found"
#endif

LOG_MODULE_REGISTER(app,LOG_LEVEL_INF);

static const struct gpio_dt_spec led = GPIO_DT_SPEC_GET(LED,gpios);

void coop_thread(void* p1,void* p2,void* p3)
{
    LOG_INF("COOPERATIVE THREAD IS RUNNING.");
    k_msleep(3000);
    LOG_INF("COOPERATIVE THREAD TASK FINISHED.");
    k_msleep(3000);
}

void preempt_thread(void* p1,void* p2, void* p3)
{
    LOG_INF("PREEMPTIVE THREAD IS RUNNING.");
    while(1){
        gpio_pin_toggle_dt(&led);
        k_msleep(500);
    }
    

}

K_THREAD_DEFINE(coop,STACK_SIZE,coop_thread,NULL,NULL,NULL,COOP_PRIORITY,0,0);
K_THREAD_DEFINE(preempt,STACK_SIZE,preempt_thread,NULL,NULL,NULL,PREEMPT_PRIORITY,0,0);


int main(){
    LOG_INF("Hello world");
   
    if(!gpio_is_ready_dt(&led)){
        LOG_ERR("GPIO");
    }

    int ret =gpio_pin_configure_dt(&led,GPIO_OUTPUT_INACTIVE);

    if(ret < 0){
        LOG_ERR("GPIO");
    }

    return 0;
}
```
