## CMakeLists.txt
```
cmake_minimum_required(VERSION 3.20.0)

# Load Zephyr build environment
find_package(Zephyr REQUIRED HINTS $ENV{ZEPHYR_BASE})

project(bava_counter_driver)

list(APPEND DTS_ROOT ${CMAKE_CURRENT_SOURCE_DIR})

zephyr_include_directories(include)

target_sources(app PRIVATE 
    src/main.c
    drivers/counter/bava_counter/bava_counter.c
)
```

## prj.conf
```kconfig
CONFIG_SERIAL=y
CONFIG_CONSOLE=y
CONFIG_UART_CONSOLE=y
CONFIG_LOG=y
CONFIG_LOG_DEFAULT_LEVEL=3

CONFIG_MULTITHREADING=y
```

## app.overlay
```dts
/{
    soc{
        fast_counter:counter_fast{
            compatible = "bava,counter";
            start-offset = <100>;
            step-size=<5>;
            status="okay";
        };
    };
};
```

## dts/bindings/counter/bava,counter.yaml
```yaml
description : Custom counter driver for learning zephyr RTOS

compatible : bava,counter

include : [base.yaml]

properties:
  start-offset: 
    type : int
    required : true
    description : the initial integer value to start

  step-size:
    type : int
    required : false
    default : 1
    description : the step size for every count
```

## src/main.c
```c
#include <zephyr/kernel.h>
#include <zephyr/logging/log.h>
#include <drivers/bava_counter.h>

LOG_MODULE_REGISTER(main_app, LOG_LEVEL_INF);

static const struct device *counter = DEVICE_DT_GET(DT_NODELABEL(fast_counter));

int main(void)
{
    int ret;
    int val = 0;

    if (!device_is_ready(counter)) {
        LOG_ERR("DEVICE NOT READY");
        return 0;
    }

    LOG_INF("STARTED........");

    while (1) {
        ret = bava_counter_get(counter, &val);
        if (ret == 0) {
            LOG_INF("COUNTER VALUE: %d", val);
        } else {
            LOG_ERR("Failed to get counter value: %d", ret);
        }
        k_msleep(1000);
    }

    return 0;
}
```
