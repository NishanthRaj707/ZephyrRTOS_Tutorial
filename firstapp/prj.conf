## CMakeLists.txt
```
# CMakeLists.txt
cmake_minimum_required(VERSION 3.20.0)

# This finds the Zephyr kernel we exported earlier
find_package(Zephyr REQUIRED HINTS $ENV{ZEPHYR_BASE})

project(firstapp)

# Add your C file to the build
target_sources(app PRIVATE src/main.c)
```

## prj.conf
```kconfig
# Enable the GPIO Driver Subsystem globally
CONFIG_GPIO=y
```

## app.overlay
```dts
/* 1. MANDATORY: Import the driver flag mappings so the parser understands "GPIO_ACTIVE_HIGH" */
#include <zephyr/dt-bindings/gpio/gpio.h>

/ {
	aliases {
		/* 2. Link your C code alias nickname to our custom hardware label */
		led = &internalled;
	};

	/* 3. Create the container node explicitly at the root level */
	leds {
		compatible = "gpio-leds";
		
		/* 4. Map the physical pin to GPIO Bank B, Pin 2 */
		internalled: ledboard {
			gpios = <&gpiob 2 GPIO_ACTIVE_HIGH>;
			label = "internal-led";
		};
	};
};
```

## src/main.c
```c
#include <zephyr/kernel.h>
#include <zephyr/drivers/gpio.h>

#define LED DT_ALIAS(led)

#if !DT_NODE_EXISTS(LED)
#error "Unsupported board: led0 device tree alias is not defined"
#endif

static const struct gpio_dt_spec led = GPIO_DT_SPEC_GET(LED,gpios);

int main(void)
{
    if(!gpio_is_ready_dt(&led))
    {
        return 0;
    }

    int temp = gpio_pin_configure_dt(&led,GPIO_OUTPUT_INACTIVE);
    if(temp<0)
    {
        return 0;
    }

    while(1)
    {
        gpio_pin_toggle_dt(&led);
        k_msleep(500);

    }
}
```
