## CMakeLists.txt
```
cmake_minimum_required(VERSION 3.20.0)

# Load Zephyr build environment
find_package(Zephyr REQUIRED HINTS $ENV{ZEPHYR_BASE})

project(zephyr_nvs_demo)

# Target executable source files
target_sources(app PRIVATE src/main.c)
```

## prj.conf
```kconfig
CONFIG_SERIAL=y
CONFIG_CONSOLE=y
CONFIG_UART_CONSOLE=y

# 1. Enable Flash Drivers & Flash Map
CONFIG_FLASH=y
CONFIG_FLASH_MAP=y
CONFIG_FLASH_PAGE_LAYOUT=y

# 2. Enable Non-Volatile Storage (NVS)
CONFIG_NVS=y

# 3. Enable Logging Subsystem
CONFIG_LOG=y
CONFIG_LOG_DEFAULT_LEVEL=3

CONFIG_MULTITHREADING=y
CONFIG_SYS_CLOCK_TICKS_PER_SEC=1000
```

## src/main.c
```c
#include <zephyr/kernel.h>
#include <zephyr/logging/log.h>
#include <zephyr/drivers/flash.h>
#include <zephyr/storage/flash_map.h>
#include <zephyr/fs/nvs.h>

#define NVS_PARTITION           storage_partition
#define NVS_PARTITION_DEVICE    FIXED_PARTITION_DEVICE(NVS_PARTITION)
#define NVS_PARTITION_OFFSET    FIXED_PARTITION_OFFSET(NVS_PARTITION)

#define RECORD_ID_BOOT_COUNT    1

LOG_MODULE_REGISTER(app, LOG_LEVEL_INF);

static struct nvs_fs fs;

static int init_nvs(void)
{
    int ret;
    struct flash_pages_info info;

    fs.flash_device = NVS_PARTITION_DEVICE;
    if (!device_is_ready(fs.flash_device)) {
        LOG_ERR("Flash device not ready");
        return -ENODEV;
    }

    fs.offset = NVS_PARTITION_OFFSET;

    ret = flash_get_page_info_by_offs(fs.flash_device, fs.offset, &info);
    if (ret != 0) {
        LOG_ERR("Failed to get flash page info (Error: %d)", ret);
        return ret;
    }

    fs.sector_size = info.size;
    fs.sector_count = 3;

    LOG_INF("Mounting NVS: Offset 0x%lx, Sector Size %u Bytes, Sectors: %u",
            (long)fs.offset, fs.sector_size, fs.sector_count);

    ret = nvs_mount(&fs);
    if (ret != 0) {
        LOG_ERR("NVS mount failed (Error: %d)", ret);
        return ret;
    }

    return 0;
}

int main(void)
{
    int ret;
    uint32_t boot_count = 0;

    LOG_INF("BAVA IS RUNNING......");

    ret = init_nvs();
    if (ret != 0) {
        LOG_ERR("NVS initialization failed!");
        return 0;
    }

    ret = nvs_read(&fs, RECORD_ID_BOOT_COUNT, &boot_count, sizeof(boot_count));
    if (ret > 0) {
        LOG_INF("Recovered Boot Count from NVS: %u", boot_count);
    } else {
        LOG_WRN("No Boot Count record found. Initializing to 0 (First Boot).");
        boot_count = 0;
    }

    boot_count++;
    ret = nvs_write(&fs, RECORD_ID_BOOT_COUNT, &boot_count, sizeof(boot_count));
    if (ret >= 0) {
        LOG_INF("Updated Boot Count to %u in Flash (Bytes written: %d)", boot_count, ret);
    } else {
        LOG_ERR("Failed to write Boot Count (Error: %d)", ret);
    }

    return 0;
}
```
