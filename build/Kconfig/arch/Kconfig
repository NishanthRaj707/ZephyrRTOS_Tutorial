## build/Kconfig/arch/Kconfig
```kconfig
# Load arch Kconfig descriptions.
osource "/home/bava/zephyrproject/zephyr/arch/x86/Kconfig"
osource "/home/bava/zephyrproject/zephyr/arch/xtensa/Kconfig"
osource "/home/bava/zephyrproject/zephyr/arch/sparc/Kconfig"
osource "/home/bava/zephyrproject/zephyr/arch/riscv/Kconfig"
osource "/home/bava/zephyrproject/zephyr/arch/posix/Kconfig"
osource "/home/bava/zephyrproject/zephyr/arch/nios2/Kconfig"
osource "/home/bava/zephyrproject/zephyr/arch/mips/Kconfig"
osource "/home/bava/zephyrproject/zephyr/arch/arm64/Kconfig"
osource "/home/bava/zephyrproject/zephyr/arch/arm/Kconfig"
osource "/home/bava/zephyrproject/zephyr/arch/arc/Kconfig"
```
