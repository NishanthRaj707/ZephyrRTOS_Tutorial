## CMakeLists.txt
```
cmake_minimum_required(VERSION 3.20.0)

# Load Zephyr build environment
find_package(Zephyr REQUIRED HINTS $ENV{ZEPHYR_BASE})

project(zephyr_workqueue_demo)

# Target executable source files
target_sources(app PRIVATE src/main.c)
```

## prj.conf
```kconfig
CONFIG_GPIO=y

CONFIG_LOG=y
CONFIG_LOG_DEFAULT_LEVEL=0
CONFIG_LOG_MODE_IMMEDIATE=n

CONFIG_SYSTEM_WORKQUEUE_PRIORITY=-1
CONFIG_SYSTEM_WORKQUEUE_STACK_SIZE=2048
```

## app.overlay
```dts
/{
    aliases{
        led=&status_led;
    };

    leds{
        compatible="gpio-leds";
        status_led:led_0{
            gpios=<&gpio0 2 GPIO_ACTIVE_HIGH>;
            label="Onboard led";
        };
    };

};
```

## src/main.c
```c
#include <zephyr/kernel.h>
#include <zephyr/drivers/gpio.h>
#include <zephyr/logging/log.h>

#define LED DT_ALIAS(led)

#if !DT_NODE_EXISTS(LED)
#error "led not found"
#endif

static const struct gpio_dt_spec led = GPIO_DT_SPEC_GET(LED,gpios);

LOG_MODULE_REGISTER(app,LOG_LEVEL_INF);

void led_on_handler(struct k_work* work){
    gpio_pin_set_dt(&led,1);
    LOG_INF("LED ON");
}

void led_off_handler(struct k_work* work){
    gpio_pin_set_dt(&led,0);
    LOG_INF("LED OFF");
}

K_WORK_DEFINE(led_on,led_on_handler);
K_WORK_DEFINE(led_off,led_off_handler);

int main(void){
    
    LOG_INF("BAVA IS STARTING ..........");
    
    if(!gpio_is_ready_dt(&led)){
        LOG_ERR("LED not ready");
        return 0;
    }

    int ret = gpio_pin_configure_dt(&led,GPIO_OUTPUT_INACTIVE);
    if(ret<0){
        LOG_ERR("LED configuration failed");
        return 0;
    }

    while(1){
        k_work_submit(&led_on);
        k_msleep(1000);
        k_work_submit(&led_off);
        k_msleep(1000);
    }
    return 0;
}
```
