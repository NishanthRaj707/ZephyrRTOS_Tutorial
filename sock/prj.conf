## CMakeLists.txt
```
cmake_minimum_required(VERSION 3.20.0)

find_package(Zephyr REQUIRED HINTS $ENV{ZEPHYR_BASE})

project(zephyr_socket)

target_sources(app PRIVATE src/main.c)
```

## prj.conf
```kconfig
CONFIG_SERIAL=y
CONFIG_CONSOLE=y
CONFIG_UART_CONSOLE=y
CONFIG_LOG=y
CONFIG_LOG_DEFAULT_LEVEL=3

CONFIG_MULTITHREADING=y
CONFIG_SYS_CLOCK_TICKS_PER_SEC=1000
CONFIG_SYSTEM_WORKQUEUE_STACK_SIZE=2048
CONFIG_MAIN_STACK_SIZE=4096

CONFIG_WIFI=y
CONFIG_WIFI_ESP32=y

CONFIG_NETWORKING=y
CONFIG_NET_L2_WIFI_MGMT=y
CONFIG_NET_L2_ETHERNET=y
CONFIG_NET_IPV4=y
CONFIG_NET_DHCPV4=y

CONFIG_NET_TCP=y
CONFIG_NET_UDP=y

CONFIG_NET_SOCKETS=y
CONFIG_NET_SOCKETS_POSIX_NAMES=y

CONFIG_DNS_RESOLVER=y

CONFIG_NET_PKT_RX_COUNT=16
CONFIG_NET_PKT_TX_COUNT=16
CONFIG_NET_BUF_RX_COUNT=32
CONFIG_NET_BUF_TX_COUNT=32
```

## src/main.c
```c
#include <zephyr/kernel.h>
#include <zephyr/logging/log.h>
#include <zephyr/net/net_if.h>
#include <zephyr/net/net_core.h>
#include <zephyr/net/net_mgmt.h>
#include <zephyr/net/socket.h>
#include <zephyr/net/wifi_mgmt.h>

LOG_MODULE_REGISTER(app,LOG_LEVEL_INF);

#define SSID "Your ssid"
#define PASS "Your password"

#define TARGET "tcpbin.com"
#define PORT "4242"

static struct net_mgmt_event_callback wifi_cb;
static struct net_mgmt_event_callback ip_cb;

K_SEM_DEFINE(wifi, 0, 1);
K_SEM_DEFINE(ip, 0, 1);


static void wifi_callback(struct net_mgmt_event_callback *cb, uint32_t event, struct net_if *iface)
{
    if(event == NET_EVENT_WIFI_CONNECT_RESULT) {
        LOG_INF(">> [Wi-Fi] Connected to AP successfully!");
        k_sem_give(&wifi);
    }
    else if (event == NET_EVENT_WIFI_DISCONNECT_RESULT) {
        LOG_WRN(">> [Wi-Fi] Disconnected from AP.");
    }
}

static void ip_callback(struct net_mgmt_event_callback *cb,uint32_t event,struct net_if* iface)
{
    if(event==NET_EVENT_IPV4_ADDR_ADD)
    {
        LOG_INF("Assigned IP");
        k_sem_give(&ip);
    }
}

static int tcp_function(void)
{
    int sock=-1;
    int ret;

    struct zsock_addrinfo hints={
        .ai_family=AF_INET,
        .ai_socktype=SOCK_STREAM,
        .ai_protocol=IPPROTO_TCP
    };

    struct zsock_addrinfo* res=NULL;

    ret=getaddrinfo(TARGET,PORT,&hints,&res);
    if(ret<0)
    {
        LOG_ERR("Failed to get addr info : %d",ret);
        return 0;
    }

    sock=zsock_socket(res->ai_family,res->ai_socktype,res->ai_protocol);

    if(sock<0)
    {
        LOG_ERR("Failed to create socket : %d",sock);
        zsock_freeaddrinfo(res);
        return 0;
    }

    ret=zsock_connect(sock,res->ai_addr,res->ai_addrlen);
    zsock_freeaddrinfo(res);
    if(ret<0)
    {
        LOG_ERR("Failed to connect : %d",ret);
        zsock_close(sock);
        return 0;
    }   
    LOG_INF("Connected to server");

    const char *msg = "Hello from Zephyr RTOS on ESP32!\n";
    ret = zsock_send(sock, msg, strlen(msg), 0);
    if (ret < 0) {
        LOG_ERR("Failed to send data: %d", errno);
        zsock_close(sock);
        return -errno;
    }
    LOG_INF("Sent %d bytes", ret);

    char buffer[1024];
    ret = zsock_recv(sock, buffer, sizeof(buffer) - 1, 0);
    if (ret < 0) {
        LOG_ERR("Failed to receive data: %d", errno);
        zsock_close(sock);
        return -errno;
    }
    buffer[ret] = '\0';
    LOG_INF("Received %d bytes: %s", ret, buffer);

    zsock_close(sock);
    return 0;
    

}

int main(void)
{
    LOG_INF("Starting socket demo");

    net_mgmt_init_event_callback(&wifi_cb,wifi_callback,NET_EVENT_WIFI_CONNECT_RESULT|NET_EVENT_WIFI_DISCONNECT_RESULT);
    net_mgmt_add_event_callback(&wifi_cb);

    net_mgmt_init_event_callback(&ip_cb,ip_callback,NET_EVENT_IPV4_ADDR_ADD);
    net_mgmt_add_event_callback(&ip_cb);

    struct net_if* iface = net_if_get_default();
    if(!iface) {
        LOG_ERR("No default net");
    }
    
    struct wifi_connect_req_params params={
        .ssid=(const uint8_t*)SSID,
        .ssid_length=strlen(SSID),
        .psk=(const uint8_t*)PASS,
        .psk_length=strlen(PASS),
        .channel=WIFI_CHANNEL_ANY,
        .security=WIFI_SECURITY_TYPE_PSK,
        .band=WIFI_FREQ_BAND_2_4_GHZ,
        .mfp=WIFI_MFP_OPTIONAL
    };

    if(net_mgmt(NET_REQUEST_WIFI_CONNECT,iface,&params,sizeof(params))!=0)
    {
        LOG_ERR("Failed to connect to WiFi");
        return 0;
    }

    if(k_sem_take(&wifi,K_SECONDS(20))!=0)
    {
        LOG_ERR("Wifi connection timed out");
        return 0;
    }

    if(k_sem_take(&ip,K_SECONDS(20))!=0)
    {
        LOG_ERR("IP acquisition timed out");
        return 0;
    }
    
    LOG_INF("Network is ready for socket operations");

    tcp_function();

    while(1)
    {
        k_msleep(5000);
    }
    return 0;
}
```
