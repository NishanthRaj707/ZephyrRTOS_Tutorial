## CMakeLists.txt
```
cmake_minimum_required(VERSION 3.20.0)

find_package(Zephyr REQUIRED HINTS $ENV{ZEPHYR_BASE})
project(esp32_pm_demo)

target_sources(app PRIVATE src/main.c)
```

## prj.conf
```kconfig
CONFIG_SERIAL=y
CONFIG_CONSOLE=y
CONFIG_UART_CONSOLE=y
CONFIG_LOG=y
CONFIG_LOG_DEFAULT_LEVEL=3

CONFIG_PM=y
CONFIG_PM_DEVICE=y
CONFIG_TICKLESS_KERNEL=y
CONFIG_POWEROFF=y

CONFIG_MULTITHREADING=y
CONFIG_SYS_CLOCK_TICKS_PER_SEC=1000
```

## app.overlay
```dts
/*
 * Devicetree overlay for Power Management (PM) & Wakeup Button
 */

/ {
    aliases {
        wakeup-button = &user_button_0;
    };

    gpio_keys {
        compatible = "gpio-keys";

        user_button_0: button_0 {
            gpios = <&gpio0 0 (GPIO_ACTIVE_LOW | GPIO_PULL_UP)>;
            label = "Wakeup Button / BOOT Pin";
        };
    };
};
```

## src/main.c
```c
#include <zephyr/kernel.h>
#include <zephyr/logging/log.h>
#include <zephyr/pm/pm.h>
#include <zephyr/sys/poweroff.h>
#include <esp_sleep.h>
#include <driver/gpio.h>

LOG_MODULE_REGISTER(app, LOG_LEVEL_INF);

static RTC_DATA_ATTR uint32_t wakeup_counter = 0;

int main(void)
{
    wakeup_counter++;

    LOG_INF("woken up %d times", wakeup_counter);

    esp_sleep_wakeup_cause_t cause = esp_sleep_get_wakeup_cause();

    LOG_INF("wakeup cause %d", cause);

    switch (cause) {
    case ESP_SLEEP_WAKEUP_TIMER:
        LOG_INF("wakeup cause timer");
        break;
    case ESP_SLEEP_WAKEUP_EXT0:
        LOG_INF("wakeup cause external pin");
        break;
    default:
        LOG_INF("wakeup cause unknown");
        break;
    }

    k_msleep(1000);

    esp_sleep_enable_timer_wakeup(5000000);

    esp_sleep_enable_ext0_wakeup(GPIO_NUM_0, 0);

    sys_poweroff();

    return 0;
}
```
